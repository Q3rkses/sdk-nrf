## sample.yaml
```
sample:
  description: Buetooth Low Energy Channel Map Update Sample
  name: Bluetooth LE Channel Map Update
tests:
  sample.bluetooth.llpm:
    sysbuild: true
    build_only: true
    integration_platforms:
      - nrf54l15dk/nrf54l05/cpuapp
      - nrf54l15dk/nrf54l10/cpuapp
      - nrf54l15dk/nrf54l15/cpuapp
      - nrf54l15bsim/nrf54l15/cpuapp
    platform_allow:
      - nrf54l15dk/nrf54l05/cpuapp
      - nrf54l15dk/nrf54l10/cpuapp
      - nrf54l15dk/nrf54l15/cpuapp
      - nrf54l15bsim/nrf54l15/cpuapp
    tags:
      - bluetooth
      - ci_build
```

## prj.conf
```kconfig
#
# Copyright (c) 2025 Nordic Semiconductor
#
# SPDX-License-Identifier: LicenseRef-Nordic-5-Clause
#

CONFIG_NCS_SAMPLES_DEFAULTS=y

CONFIG_BT_DEVICE_NAME="CHMAP Update Sample"

# Enable BT configs
CONFIG_BT=y
CONFIG_BT_PERIPHERAL=y
CONFIG_BT_CENTRAL=y
CONFIG_BT_GATT_CLIENT=y
CONFIG_BT_GATT_DM=y
CONFIG_BT_SCAN=y

# Config for console/logger
CONFIG_CONSOLE=y
CONFIG_UART_CONSOLE=y
CONFIG_CONSOLE_SUBSYS=y
CONFIG_CONSOLE_GETCHAR=y

# Scan and connect 1-1
CONFIG_BT_MAX_CONN=1
CONFIG_BT_SMP=y
CONFIG_BT_SCAN_FILTER_ENABLE=y
CONFIG_BT_SCAN_UUID_CNT=1

# Enable Nordic Latency Service
CONFIG_BT_LATENCY=y
CONFIG_BT_LATENCY_CLIENT=y

CONFIG_BT_HCI_VS_EVT_USER=y
CONFIG_HEAP_MEM_POOL_SIZE=2048
CONFIG_BT_GAP_PERIPHERAL_PREF_PARAMS=n

#In order to print out floats
CONFIG_FPU=y
CONFIG_CBPRINTF_FP_SUPPORT=y

#Needed for random selection
CONFIG_ENTROPY_GENERATOR=y
```

## src/main.c
```c
/*
 * Copyright (c) 2025 Nordic Semiconductor ASA
 *
 * SPDX-License-Identifier: LicenseRef-Nordic-5-Clause
 */

#include <zephyr/console/console.h>
#include <string.h>
#include <stdlib.h>
#include <zephyr/sys/printk.h>
#include <zephyr/types.h>

#include <zephyr/kernel.h>
#include <zephyr/bluetooth/bluetooth.h>
#include <zephyr/bluetooth/conn.h>
#include <zephyr/bluetooth/gatt.h>
#include <zephyr/bluetooth/hci.h>
#include <zephyr/bluetooth/buf.h>
#include <zephyr/bluetooth/uuid.h>
#include <zephyr/sys/byteorder.h>
#include <bluetooth/services/latency.h>
#include <bluetooth/services/latency_client.h>
#include <bluetooth/scan.h>
#include <bluetooth/gatt_dm.h>
#include <bluetooth/hci_vs_sdc.h>
#include <bluetooth/hci_vs_sdc.h>
#include "filter_algo.h"

#define DEVICE_NAME		   CONFIG_BT_DEVICE_NAME
#define DEVICE_NAME_LEN		   (sizeof(DEVICE_NAME) - 1)
#define INTERVAL_UNITS		   0x6	/* 6 units,  7.5 ms */
#define FILTER_EVALUATION_INTERVAL 2000 /* Evaluate every 2000 packets */
#define CHMAP_BT_CONN_CH_COUNT	   37
#define CHMAP_BLE_BITMASK_SIZE	   5

static K_SEM_DEFINE(test_ready_sem, 0, 1);
static bool test_ready;
static struct bt_conn *default_conn;
static struct bt_latency latency;
static struct bt_latency_client latency_client;
static struct bt_le_conn_param *conn_param =
	/* Use standard 7.5 ms connection interval (6 * 1.25 ms) */
	BT_LE_CONN_PARAM(INTERVAL_UNITS, INTERVAL_UNITS, 0, 400);
static struct bt_conn_info conn_info = {0};

static const struct bt_data ad[] = {
	BT_DATA_BYTES(BT_DATA_FLAGS, (BT_LE_AD_GENERAL | BT_LE_AD_NO_BREDR)),
	BT_DATA_BYTES(BT_DATA_UUID128_ALL, BT_UUID_LATENCY_VAL),
};

static const struct bt_data sd[] = {
	BT_DATA(BT_DATA_NAME_COMPLETE, DEVICE_NAME, DEVICE_NAME_LEN),
};

static struct chmap_instance filter_chmap_instance;
static uint32_t total_packets_sent = 0;
static uint32_t packets_since_last_evaluation = 0;

static void init_channel_map(void)
{
	memset(&filter_chmap_instance, 0, sizeof(filter_chmap_instance));
	channel_map_filter_algo_init(&filter_chmap_instance);

	total_packets_sent = 0;
	packets_since_last_evaluation = 0;

	printk("Channel map and algorithm initialized\n");
	printk("Algorithm will evaluate every %d packets\n", FILTER_EVALUATION_INTERVAL);
}

static int read_conn_channel_map(struct bt_conn *conn, uint8_t out_map[5])
{
	if (!conn || !out_map) {
		return -EINVAL;
	}

	uint16_t handle;
	int err = bt_hci_get_conn_handle(conn, &handle);
	if (err) {
		return err;
	}

	struct net_buf *buf = bt_hci_cmd_create(BT_HCI_OP_LE_READ_CHAN_MAP,
						sizeof(struct bt_hci_cp_le_read_chan_map));
	if (!buf) {
		return -ENOBUFS;
	}

	struct bt_hci_cp_le_read_chan_map *cp = net_buf_add(buf, sizeof(*cp));
	cp->handle = sys_cpu_to_le16(handle);

	struct net_buf *rsp = NULL;
	err = bt_hci_cmd_send_sync(BT_HCI_OP_LE_READ_CHAN_MAP, buf, &rsp);
	if (err) {
		if (rsp) {
			net_buf_unref(rsp);
		}
		return err;
	}

	const struct bt_hci_rp_le_read_chan_map *rp = (void *)rsp->data;
	memcpy(out_map, rp->ch_map, sizeof(rp->ch_map));
	net_buf_unref(rsp);
	return 0;
}

void algorithm_evaluation_and_update(void)
{

	int eval_result = channel_map_filter_algo_evaluate(&filter_chmap_instance);

	if (eval_result == 1) { /* Algorithm performed evaluation, get new channel map */
		uint8_t *new_channel_map =
			channel_map_filter_algo_get_channel_map(&filter_chmap_instance);

		if (new_channel_map) { /* Apply new map */
			printk("Applying new channel map\n");

			int err = bt_le_set_chan_map(new_channel_map);
			if (err) {
				printk("Failed to apply channel map (err %d)\n", err);
			} else {
				printk("Successfully applied channel map\n");
				set_suggested_bitmask_to_current_bitmask(&filter_chmap_instance);
			}
		}
	} else if (eval_result == 0) {
		return;

	} else {
		printk("Algorithm evaluation failed (err %d)\n", eval_result);
	}

	packets_since_last_evaluation = 0;
}

void scan_filter_match(struct bt_scan_device_info *device_info,
		       struct bt_scan_filter_match *filter_match, bool connectable)
{
	char addr[BT_ADDR_LE_STR_LEN];

	bt_addr_le_to_str(device_info->recv_info->addr, addr, sizeof(addr));

	printk("Filters matched. Address: %s connectable: %d\n\n", addr, connectable);
}

void scan_filter_no_match(struct bt_scan_device_info *device_info, bool connectable)
{
	char addr[BT_ADDR_LE_STR_LEN];

	bt_addr_le_to_str(device_info->recv_info->addr, addr, sizeof(addr));

	printk("Filter does not match. Address: %s connectable: %d\n", addr, connectable);
}

void scan_connecting_error(struct bt_scan_device_info *device_info)
{
	printk("Connecting failed\n");
}

BT_SCAN_CB_INIT(scan_cb, scan_filter_match, scan_filter_no_match, scan_connecting_error, NULL);

static void scan_init(void)
{
	int err;
	struct bt_le_scan_param scan_param = {
		.type = BT_LE_SCAN_TYPE_PASSIVE,
		.options = BT_LE_SCAN_OPT_FILTER_DUPLICATE,
		.interval = 0x0010,
		.window = 0x0010,
	};

	struct bt_scan_init_param scan_init = {
		.connect_if_match = true, .scan_param = &scan_param, .conn_param = conn_param};

	bt_scan_init(&scan_init);
	bt_scan_cb_register(&scan_cb);

	err = bt_scan_filter_add(BT_SCAN_FILTER_TYPE_UUID, BT_UUID_LATENCY);
	if (err) {
		printk("Scanning filters cannot be set (err %d)\n", err);
		return;
	}

	err = bt_scan_filter_enable(BT_SCAN_UUID_FILTER, false);
	if (err) {
		printk("Filters cannot be turned on (err %d)\n", err);
	}
}

static void discovery_complete(struct bt_gatt_dm *dm, void *context)
{
	struct bt_latency_client *latency = context;

	printk("Service discovery completed\n\n");

	bt_gatt_dm_data_print(dm);
	bt_latency_handles_assign(dm, latency);
	bt_gatt_dm_data_release(dm);

	/* Start testing when the GATT service is discovered */
	test_ready = true;
	k_sem_give(&test_ready_sem);
}

static void discovery_service_not_found(struct bt_conn *conn, void *context)
{
	printk("Service not found\n");
}

static void discovery_error(struct bt_conn *conn, int err, void *context)
{
	printk("Error while discovering GATT database: (err %d)\n", err);
}

struct bt_gatt_dm_cb discovery_cb = {
	.completed = discovery_complete,
	.service_not_found = discovery_service_not_found,
	.error_found = discovery_error,
};

static void adv_start(void)
{
	int err;

	err = bt_le_adv_start(BT_LE_ADV_CONN_FAST_2, ad, ARRAY_SIZE(ad), sd, ARRAY_SIZE(sd));
	if (err) {
		printk("Advertising failed to start (err %d)\n", err);
		return;
	}

	printk("Advertising successfully started\n");
}

static void scan_start(void)
{
	int err;

	err = bt_scan_start(BT_SCAN_TYPE_SCAN_PASSIVE);
	if (err) {
		printk("Starting scanning failed (err %d)\n", err);
		return;
	}

	printk("Scanning successfully started\n\n");
}

static void connected(struct bt_conn *conn, uint8_t err)
{
	if (err) {
		printk("Connection failed, err 0x%02x %s\n", err, bt_hci_err_to_str(err));
		return;
	}

	default_conn = bt_conn_ref(conn);
	err = bt_conn_get_info(default_conn, &conn_info);
	if (err) {
		printk("Getting conn info failed (err %d)\n", err);
		return;
	}

	/* make sure we're not scanning or advertising */
	if (conn_info.role == BT_CONN_ROLE_CENTRAL) {
		bt_scan_stop();

#if !defined(CONFIG_BT_SMP)
		/* With SMP disabled (e.g., in BabbleSim), start discovery immediately */
		err = bt_gatt_dm_start(default_conn, BT_UUID_LATENCY, &discovery_cb,
				       &latency_client);
		if (err) {
			printk("Discover failed (err %d)\n", err);
		}
#endif /* !CONFIG_BT_SMP */

	} else {
		bt_le_adv_stop();

#if defined(CONFIG_BT_SMP)
		err = bt_conn_set_security(conn, BT_SECURITY_L2);
		if (err) {
			printk("Failed to set security: %d\n", err);
		}
#else
		/* Peripheral does not need discovery gating; mark test ready */
		test_ready = true;
		k_sem_give(&test_ready_sem);
#endif /* CONFIG_BT_SMP */
	}

	printk("Connected as %s\n",
	       conn_info.role == BT_CONN_ROLE_CENTRAL ? "central" : "peripheral");
	printk("Connection interval: %d units (%.1f ms)\n", conn_info.le.interval,
	       conn_info.le.interval * 1.25);
}

static void disconnected(struct bt_conn *conn, uint8_t reason)
{
	printk("Disconnected, reason 0x%02x %s\n", reason, bt_hci_err_to_str(reason));

	test_ready = false;

	if (default_conn) {
		bt_conn_unref(default_conn);
		default_conn = NULL;
	}

	if (conn_info.role == BT_CONN_ROLE_CENTRAL) {
		scan_start();
	} else {
		adv_start();
	}
}

static bool on_vs_evt(struct net_buf_simple *buf)
{

	if (conn_info.role !=
	    BT_CONN_ROLE_CENTRAL) { /* if peripheral gets inside callback, simply leave*/
		return true;
	}

	uint8_t code;
	sdc_hci_subevent_vs_qos_conn_event_report_t *evt;

	code = net_buf_simple_pull_u8(buf);
	if (code != SDC_HCI_SUBEVENT_VS_QOS_CONN_EVENT_REPORT) {
		return false;
	}

	evt = (void *)buf->data;

	uint8_t channel_index = evt->channel_index;
	if (channel_index >= CHMAP_BT_CONN_CH_COUNT) {
		printk("Invalid channel index: %d (max allowed: %d)\n", channel_index,
		       CHMAP_BT_CONN_CH_COUNT - 1);
		return false;
	}

	total_packets_sent++;
	packets_since_last_evaluation++;
	filter_chmap_instance.processed_samples_count++; /* total count (all packets)*/
	filter_chmap_instance.bt_channels[channel_index]
		.total_packets_sent++; /*local count (per channel packets)*/

	if (evt->crc_error_count > 0) { /* CRC error occurred */
		filter_chmap_instance.bt_channels[channel_index].total_crc_errors++;
	} else {
		filter_chmap_instance.bt_channels[channel_index].total_crc_ok++;
	}

	if (evt->rx_timeout > 0) { /* rx-timeout occurred */
		filter_chmap_instance.bt_channels[channel_index].total_rx_timeouts +=
			evt->rx_timeout;
	}

	if (packets_since_last_evaluation >= FILTER_EVALUATION_INTERVAL) {
		algorithm_evaluation_and_update();
	}

	return true;
}

static int enable_qos_conn_evt_report(void)
{
	int err;
	sdc_hci_cmd_vs_qos_conn_event_report_enable_t cmd_enable;

	err = bt_hci_register_vnd_evt_cb(on_vs_evt);
	if (err) {
		printk("Failed registering vendor specific callback (err %d)\n", err);
		return err;
	}

	cmd_enable.enable = true;

	err = hci_vs_sdc_qos_conn_event_report_enable(&cmd_enable);
	if (err) {
		printk("Could not enable QoS reports (err %d)\n", err);
		return err;
	}

	printk("Connection event reports enabled\n");
	return 0;
}

static void test_run(void)
{
	int err;
	if (!test_ready) {
		/* disconnected while blocking inside _getchar() */
		return;
	}

	test_ready = false;
	uint8_t previous_active_map[CHMAP_BLE_BITMASK_SIZE] = {0};
	uint8_t active_map[CHMAP_BLE_BITMASK_SIZE] = {0};

	/* Start sending data to trigger packet events */
	while (default_conn) {
		uint32_t time = k_cycle_get_32();

		if (conn_info.role == BT_CONN_ROLE_CENTRAL) {
			err = bt_latency_request(&latency_client, &time, sizeof(time));
			if (err && err != -EALREADY) {
				printk("Latency request failed (err %d)\n", err);
			}
		}

		if (conn_info.role == BT_CONN_ROLE_PERIPHERAL) {
			/* Read back controller's active channel map for verification */
			err = read_conn_channel_map(default_conn, active_map);
			if (!err) {
				if (memcmp(active_map, previous_active_map,
					   CHMAP_BLE_BITMASK_SIZE) != 0) {

					printk("Detected Channel Map Update. (Format: CH36 -> "
					       "CH0)\n");

					/* Print channel map in Hexadecimal */
					printk("LL channel map, HEX: %02x %02x %02x %02x "
					       "%02x\n",
					       active_map[4], active_map[3], active_map[2],
					       active_map[1], active_map[0]);

					/* Print channel map in Bits */
					char bitstr[CHMAP_BT_CONN_CH_COUNT + 1];
					for (int ch = CHMAP_BT_CONN_CH_COUNT - 1; ch >= 0; ch--) {
						uint8_t bit =
							(active_map[ch / 8] >> (ch % 8)) & 0x01;
						bitstr[CHMAP_BT_CONN_CH_COUNT - 1 - ch] =
							bit ? '1' : '0';
					}
					bitstr[CHMAP_BT_CONN_CH_COUNT] = '\0';
					printk("LL channel map, BITS: %s\n\n", bitstr);

					/* Copy & replace map for next evaluation */
					memcpy(previous_active_map, active_map,
					       CHMAP_BLE_BITMASK_SIZE);
				}
			} else {
				printk("Reading LL channel map failed (err %d)\n", err);
			}
		}
		k_sleep(K_MSEC(1)); /* Wait between requests */
	}
}

#if defined(CONFIG_BT_SMP)
void security_changed(struct bt_conn *conn, bt_security_t level, enum bt_security_err err)
{
	printk("Security changed: level %i, err: %i %s\n", level, err, bt_security_err_to_str(err));

	if (err != 0) {
		printk("Failed to encrypt link\n");
		bt_conn_disconnect(conn, BT_HCI_ERR_PAIRING_NOT_SUPPORTED);
		return;
	}
	/* Start service discovery when link is encrypted */
	err = bt_gatt_dm_start(default_conn, BT_UUID_LATENCY, &discovery_cb, &latency_client);
	if (err) {
		printk("Discover failed (err %d)\n", err);
	}
}
#endif /* CONFIG_BT_SMP */

BT_CONN_CB_DEFINE(conn_callbacks) = {
	.connected = connected,
	.disconnected = disconnected,
#if defined(CONFIG_BT_SMP)
	.security_changed = security_changed,
#endif /* CONFIG_BT_SMP */
};

int main(void)
{
	int err;
	printk("Starting Bluetooth Channel Map Update Sample\n");

	console_init();

	err = bt_enable(NULL);
	if (err) {
		printk("Bluetooth init failed (err %d)\n", err);
		return 0;
	}

	printk("Bluetooth initialized\n");

	err = bt_latency_init(&latency, NULL);
	if (err) {
		printk("Latency service initialization failed (err %d)\n", err);
		return 0;
	}

	err = bt_latency_client_init(&latency_client, NULL);
	if (err) {
		printk("Latency client initialization failed (err %d)\n", err);
		return 0;
	}

	while (true) {
		printk("Choose device role - type c (central) or p (peripheral): \n");

		char input_char = console_getchar();

		if (input_char == 'c') {
			printk("Central. Starting scanning\n");
			init_channel_map();
			scan_init();
			scan_start();

			if (enable_qos_conn_evt_report()) { /* Enable QoS only central */
				printk("Enable QoS reports failed.\n");
				return 0;
			}

			break;
		} else if (input_char == 'p') {
			printk("Peripheral. Starting advertising\n");
			adv_start();
			break;
		}

		printk("Invalid role\n");
	}

	for (;;) {
		k_sem_take(&test_ready_sem, K_FOREVER);
		test_run();
	}
}
```

## include/filter_algo.h
```c
/*
 * Copyright (c) 2025 Nordic Semiconductor ASA
 *
 * SPDX-License-Identifier: LicenseRef-Nordic-5-Clause
 */

#ifndef FILTER_ALGO_H
#define FILTER_ALGO_H

#include <stdint.h>
#include <stdbool.h>

/**
 * @file
 * @defgroup Channel_Map_Update Definitions for the Autonomous Map update sample.
 * @{
 * @brief Definitions for the Autonomous Map update sample.
 *
 * This file contains common definitions and API declarations
 * used by the sample.
 */

/* Constants */
#define CHMAP_BT_CONN_CH_COUNT 37
#define CHMAP_BLE_BITMASK_SIZE 5

/* Forward declarations */
struct chmap_instance;
struct chmap_filter_params;
struct chmap_qos_sample;

/* Algorithm weight parameters */
struct chmap_filter_params {
	float w_1;			  /* Weight for CRC errors */
	float w_2;			  /* Weight for RX timeouts */
	float w_3;			  /* Weight for old rating */
	float rating_threshold;		  /* Threshold for disabling channels */
	uint16_t min_packets_per_channel; /* Minimum packets needed for rating */
};

/* QoS sample structure */
struct chmap_qos_sample {
	uint8_t channel_index;
	uint16_t packets_sent;
	uint16_t crc_ok_count;
	uint16_t crc_error_count;
	uint16_t rx_timeout_count;
};

/* Channel data structure */
struct chmap_channel {
	float rating;
	float prev_rating;
	uint8_t state;
	uint8_t cooldown_time_remaining; /* 0=disabled, 1=enabled, 2=cooldown */
	uint16_t total_packets_sent;
	uint16_t total_crc_ok;
	uint16_t total_crc_errors;
	uint16_t total_rx_timeouts;
};

/* Main channel map instance */
struct chmap_instance {
	struct chmap_filter_params parameters;
	struct chmap_channel bt_channels[CHMAP_BT_CONN_CH_COUNT];
	uint8_t desired_active_channels;
	uint8_t min_active_channels;
	uint8_t active_channel_count;
	uint8_t suggested_chn_bitmask[CHMAP_BLE_BITMASK_SIZE];
	uint8_t current_chn_bitmask[CHMAP_BLE_BITMASK_SIZE];
	uint16_t processed_samples_count;
	uint8_t evaluations_since_last_evaluation;
};

#ifdef __cplusplus
extern "C" {
#endif

/**
 * @brief Initialize the channel map algorithm
 *
 * @param chmap_instance Pointer to the channel map instance
 */
void channel_map_filter_algo_init(struct chmap_instance *chmap_instance);

/**
 * @brief Check if algorithm is ready for evaluation and perform it
 *
 * @param chmap_instance Pointer to the channel map instance
 * @return 1 if evaluation was performed, 0 if not ready, negative on error
 */
int channel_map_filter_algo_evaluate(struct chmap_instance *chmap_instance);

/**
 * @brief Get the suggested channel map
 *
 * @param chmap_instance Pointer to the channel map instance
 * @return Pointer to the suggested channel map bitmask (5 bytes)
 */
uint8_t *channel_map_filter_algo_get_channel_map(struct chmap_instance *chmap_instance);

/**
 * @brief Set algorithm parameters
 *
 * @param chmap_instance Pointer to the channel map instance
 * @param params Pointer to the new parameters
 */
void channel_map_filter_algo_set_parameters(struct chmap_instance *chmap_instance,
					    const struct chmap_filter_params *params);

/**
 * @brief Set algorithm preferences, falls back to defaults if not used
 *
 * @param chmap_instance Pointer to the channel map instance
 * @param desired_active_channels The desired amount of channels the filter should operate at
 * @param min_active_channels The minimum amount of channels that have to remain non-blocked
 */
void channel_map_filter_set_preferences(struct chmap_instance *chmap_instance,
					const uint8_t desired_active_channels,
					const uint8_t min_active_channels);

/**
 * @brief Function to reset the counters (data) used in a sample
 *
 * @param chmap_instance Pointer to the channel map instance
 */
void reset_sample_counters(struct chmap_instance *chmap_instance);

/**
 * @brief Function to set the suggested channel bitmask to current channel bitmask
 *
 * @param chmap_instance Pointer to the channel map instance
 */
void set_suggested_bitmask_to_current_bitmask(struct chmap_instance *chmap_instance);

#ifdef __cplusplus
}
#endif

#endif // FILTER_ALGO_H
```

## src/filter_algo.c
```c
/*
 * Copyright (c) 2025 Nordic Semiconductor ASA
 *
 * SPDX-License-Identifier: LicenseRef-Nordic-5-Clause
 */

#include <stdint.h>
#include <string.h>
#include <stdbool.h>
#include <stdio.h>
#include <zephyr/random/random.h>
#include <zephyr/bluetooth/hci.h>

#define CHMAP_BT_CONN_CH_COUNT		      37
#define CHMAP_BLE_BITMASK_SIZE		      5
#define CHMAP_DEFAULT_DESIRED_ACTIVE_CHANNELS 30
#define CHMAP_DEFAULT_MIN_ACTIVE_CHANNELS     5
#define FILTER_EVALUATION_SAMPLE_COUNT	      2000
#define FILTER_EVALUATIONS_BEFORE_RESET_COUNT 3

#define PERFECT_RATING		 1.0
#define CRC_WEIGHT		 0.15
#define RX_TIMEOUT_WEIGHT	 0.85
#define OLD_RATING_WEIGHT	 0.85
#define RATING_THRESHOLD	 0.8
#define MINIMUM_PACKETS_PER_CHAN 10

struct chmap_filter_params {
	float w_1;
	float w_2;
	float w_3;
	float rating_threshold;
	uint16_t min_packets_per_channel;
};

struct chmap_channel {
	float rating;
	float prev_rating;
	uint8_t state;
	uint8_t cooldown_time_remaining;
	uint16_t total_packets_sent;
	uint16_t total_crc_ok;
	uint16_t total_crc_errors;
	uint16_t total_rx_timeouts;
};

struct chmap_instance {
	struct chmap_filter_params parameters;
	struct chmap_channel bt_channels[CHMAP_BT_CONN_CH_COUNT];
	uint8_t desired_active_channels;
	uint8_t min_active_channels;
	uint8_t active_channel_count;
	uint8_t suggested_chn_bitmask[CHMAP_BLE_BITMASK_SIZE];
	uint8_t current_chn_bitmask[CHMAP_BLE_BITMASK_SIZE];
	uint16_t processed_samples_count;
	uint8_t evaluations_since_last_evaluation;
};

static void calculate_channel_ratings(struct chmap_instance *chmap_instance);
static void generate_channel_map(struct chmap_instance *chmap_instance);
static void reset_sample_counters(struct chmap_instance *chmap_instance);
static void set_default_parameters(struct chmap_filter_params *params);
static void decrement_cooldown_time_and_update_state(struct chmap_instance *chmap_instance);
static void add_random_channel_to_channel_map(struct chmap_instance *chmap_instance);
void channel_map_filter_set_preferences(struct chmap_instance *chmap_instance,
					const uint8_t desired_active_channels,
					const uint8_t min_active_channels);

float crc_error_rate;
float rx_timeout_rate;
float new_rating;

void channel_map_filter_algo_init(struct chmap_instance *chmap_instance)
{
	memset(chmap_instance, 0, sizeof(struct chmap_instance));

	set_default_parameters(&chmap_instance->parameters);

	/* Set default preferences on filter */
	channel_map_filter_set_preferences(chmap_instance, CHMAP_DEFAULT_DESIRED_ACTIVE_CHANNELS,
					   CHMAP_DEFAULT_MIN_ACTIVE_CHANNELS);

	/* Initialize all channels as enabled with perfect rating */
	for (int i = 0; i < CHMAP_BT_CONN_CH_COUNT; i++) {
		chmap_instance->bt_channels[i].rating = PERFECT_RATING;
		chmap_instance->bt_channels[i].prev_rating = PERFECT_RATING;
		chmap_instance->bt_channels[i].state = 1;
		chmap_instance->bt_channels[i].cooldown_time_remaining = 0;
	}

	/* Initialize channel map with all channels enabled */
	memset(chmap_instance->current_chn_bitmask, 0xFF, CHMAP_BLE_BITMASK_SIZE);
	memset(chmap_instance->suggested_chn_bitmask, 0xFF, CHMAP_BLE_BITMASK_SIZE);

	chmap_instance->active_channel_count = CHMAP_BT_CONN_CH_COUNT;
	chmap_instance->processed_samples_count = 0;
	chmap_instance->evaluations_since_last_evaluation = 0;
}

void print_channel_stats(struct chmap_instance *chmap_instance)
{
	if (!chmap_instance) {
		printk("ERROR: chmap_instance is NULL!\n");
		return;
	}

	printk("\n--- Algorithm Channel Report ---");
	printk("Ch | Total_packets_sent  | CRC_Errors | RX_Timeouts | Rating Made | Last Rating | "
	       "State");
	printk("---|---------------------|------------|-------------|-------------|-------------|-"
	       "------");

	for (int i = 0; i < CHMAP_BT_CONN_CH_COUNT; i++) {
		struct chmap_channel channel_data = chmap_instance->bt_channels[i];
		float rating_used_this_sample = channel_data.rating;
		float rating_used_prev_sample = channel_data.prev_rating;

		printk("%2d | %19d | %10d | %11d | %11.3f | %11.3f | %d", i,
		       channel_data.total_packets_sent, channel_data.total_crc_errors,
		       channel_data.total_rx_timeouts, (double)rating_used_this_sample,
		       (double)rating_used_prev_sample, channel_data.state);
	}
}

int channel_map_filter_algo_evaluate(struct chmap_instance *chmap_instance)
{
	if (!chmap_instance) {
		return -1;
	}

	if (chmap_instance->processed_samples_count < FILTER_EVALUATION_SAMPLE_COUNT) {
		return 0;
	}

	decrement_cooldown_time_and_update_state(chmap_instance);
	calculate_channel_ratings(chmap_instance);
	generate_channel_map(chmap_instance);

	/* Add random channels that are done with cooldown to suggested channel map if we are
	running low on channels */
	if (chmap_instance->active_channel_count < chmap_instance->desired_active_channels) {
		add_random_channel_to_channel_map(chmap_instance);
	}

	if (chmap_instance->evaluations_since_last_evaluation >
	    FILTER_EVALUATIONS_BEFORE_RESET_COUNT) {
		print_channel_stats(chmap_instance);
		reset_sample_counters(chmap_instance);
	}

	printk("Channel map evaluation completed successfully");
	printk("\nActive channels: %d\n", chmap_instance->active_channel_count);

	chmap_instance->evaluations_since_last_evaluation++;
	return 1; /* Evaluation performed */
}

/* TODO: Instead of picking channels which are to be tested again at random use Channel Sounding */

/* Decrement cooldown_time for channel, and update state if cooldown_time is over */
static void decrement_cooldown_time_and_update_state(struct chmap_instance *chmap_instance)
{
	for (int i = 0; i < CHMAP_BT_CONN_CH_COUNT; i++) {
		if (chmap_instance->bt_channels[i].cooldown_time_remaining < 1) {
			continue;
		}
		chmap_instance->bt_channels[i].cooldown_time_remaining--;
		/* If decrementation lead to cooldown_time_remaining = 0, update state too */
		if (chmap_instance->bt_channels[i].cooldown_time_remaining == 0 &&
		    chmap_instance->bt_channels[i].state == 2) {
			chmap_instance->bt_channels[i].state = 0;
		}
	}
}

static void add_random_channel_to_channel_map(struct chmap_instance *chmap_instance)
{
	/* Count number of channels with state 0 */
	uint8_t candidates[CHMAP_BT_CONN_CH_COUNT];
	size_t candidate_count = 0;

	for (int i = 0; i < CHMAP_BT_CONN_CH_COUNT; i++) {
		if (chmap_instance->bt_channels[i].state == 0) {
			candidates[candidate_count++] = i;
		}
	}

	if (candidate_count == 0) {
		return;
	}

	/* Decide how many channels should be added to the channel map */
	int add_channel_to_channel_map_count;
	if (chmap_instance->active_channel_count > 20) {
		add_channel_to_channel_map_count = 1;
	} else if (chmap_instance->active_channel_count > 10) {
		add_channel_to_channel_map_count = 2;
	} else {
		add_channel_to_channel_map_count = 3;
	}

	if (add_channel_to_channel_map_count > (int)candidate_count) {
		add_channel_to_channel_map_count = candidate_count;
	}

	/* Pick a random random channel witstate = 0 and add it ti the channel map. */
	for (int k = 0; k < add_channel_to_channel_map_count; k++) {
		uint32_t r = k + (sys_rand32_get() % (candidate_count - k));

		uint8_t tmp = candidates[k];
		candidates[k] = candidates[r];
		candidates[r] = tmp;
		uint8_t ch_idx = candidates[k];

		chmap_instance->bt_channels[ch_idx].state = 1;
		/* update so previous rating is correct */
		chmap_instance->bt_channels[ch_idx].prev_rating =
			chmap_instance->bt_channels[ch_idx].rating;
		chmap_instance->active_channel_count++;

		uint8_t byte = ch_idx / 8;
		uint8_t bit = ch_idx % 8;
		chmap_instance->suggested_chn_bitmask[byte] |= (1 << bit);
	}
}

uint8_t *channel_map_filter_algo_get_channel_map(struct chmap_instance *chmap_instance)
{
	if (!chmap_instance) {
		return NULL;
	}

	return chmap_instance->suggested_chn_bitmask;
}

void channel_map_filter_set_preferences(struct chmap_instance *chmap_instance,
					const uint8_t desired_active_channels,
					const uint8_t min_active_channels)
{
	if (!chmap_instance) {
		return;
	}

	if (desired_active_channels < min_active_channels || desired_active_channels > 40 ||
	    min_active_channels < 3) {
		printk("Desired filter preferences are out of bounds, pivoting to default values");
		chmap_instance->desired_active_channels = 35;
		chmap_instance->min_active_channels = 3;
	}

	else {
		chmap_instance->desired_active_channels = desired_active_channels;
		chmap_instance->min_active_channels = min_active_channels;
	}
}

void channel_map_filter_algo_set_parameters(struct chmap_instance *chmap_instance,
					    const struct chmap_filter_params *params)
{
	if (!chmap_instance || !params) {
		return;
	}

	if (params->w_1 < 0.0f || params->w_1 > 1.0f) {
		printk("Invalid w_1 value: %f, clamping to 0.0", (double)params->w_1);
		return;
	} else if (params->w_2 < 0.0f || params->w_2 > 1.0f) {
		printk("Invalid w_2 value: %f, clamping to 0.0", (double)params->w_2);
		return;
	} else if (params->w_1 + params->w_2 != 1.0f) {
		printk("Invalid combination of w_1 and w_2. The sum of them should be 1.0 (w1: "
		       "%f, w2: %f)",
		       (double)params->w_1, (double)params->w_2);
		return;
	}

	chmap_instance->parameters = *params;
}

static void set_default_parameters(struct chmap_filter_params *params)
{
	params->w_1 = CRC_WEIGHT;
	params->w_2 = RX_TIMEOUT_WEIGHT;
	params->w_3 = OLD_RATING_WEIGHT;
	params->rating_threshold = RATING_THRESHOLD;
	params->min_packets_per_channel = MINIMUM_PACKETS_PER_CHAN;
}

static void calculate_channel_ratings(struct chmap_instance *chmap_instance)
{
	for (int i = 0; i < CHMAP_BT_CONN_CH_COUNT; i++) {
		struct chmap_channel *channel = &chmap_instance->bt_channels[i];
		uint16_t packets_sent = chmap_instance->bt_channels[i].total_packets_sent;

		/* Skip channels where state isn't 1 */
		if (channel->state != 1) {
			continue;
		}

		/* Skip channels with insufficient data */
		if (packets_sent < chmap_instance->parameters.min_packets_per_channel) {
			continue;
		}

		if (packets_sent == 0) {
			printk("Zero packets sent for channel %d", i);
			continue;
		}

		/* Calculate error rates */
		crc_error_rate = (float)channel->total_crc_errors / packets_sent;
		rx_timeout_rate = (float)channel->total_rx_timeouts / packets_sent;

		new_rating = (1.0f - chmap_instance->parameters.w_3) * channel->prev_rating +
			     chmap_instance->parameters.w_3 *
				     (1.0f - (chmap_instance->parameters.w_1 * crc_error_rate +
					      chmap_instance->parameters.w_2 * rx_timeout_rate));

		/* Clamp rating between 0 and 1 */
		if (new_rating < 0.0f) {
			printk("Rating below 0.0 (%f), clamping to 0.0", (double)new_rating);
			new_rating = 0.0f;
		} else if (new_rating > 1.0f) {
			printk("Rating above 1.0 (%f), clamping to 1.0", (double)new_rating);
			new_rating = 1.0f;
		}

		channel->prev_rating = channel->rating;
		channel->rating = new_rating;

		/* update channel state, should be set to cooldown if rating below threshold. */
		if (channel->rating < chmap_instance->parameters.rating_threshold &&
		    channel->state == 1) {
			channel->state = 2;
			channel->cooldown_time_remaining = 2;
		}
	}
}

static void generate_channel_map(struct chmap_instance *chmap_instance)
{
	memset(chmap_instance->suggested_chn_bitmask, 0, CHMAP_BLE_BITMASK_SIZE);

	uint8_t active_count = 0;

	/* Enable channels above threshold */
	for (int i = 0; i < CHMAP_BT_CONN_CH_COUNT; i++) {
		/* Skip channel if channel has cooldown or it is disabled */
		if (chmap_instance->bt_channels[i].state == 2 ||
		    chmap_instance->bt_channels[i].state == 0) {
			continue;
		}
		if (chmap_instance->bt_channels[i].rating >=
		    chmap_instance->parameters.rating_threshold) {
			int byte_index = i / 8;
			int bit_index = i % 8;
			chmap_instance->suggested_chn_bitmask[byte_index] |= (1 << bit_index);
			chmap_instance->bt_channels[i].state = 1;
			active_count++;
		} else {
			chmap_instance->bt_channels[i].state = 0;
		}
	}

	if (active_count < chmap_instance->min_active_channels) {
		printk("Warning: Too few active channels (%d), enabling best channels\n",
		       active_count);

		/* Find and enable the best channels */
		for (int needed = chmap_instance->min_active_channels - active_count; needed > 0;
		     needed--) {
			float best_rating = -1.0f;
			int best_channel = -1;

			for (int i = 0; i < chmap_instance->min_active_channels; i++) {
				if ((chmap_instance->bt_channels[i].state == 0 ||
				     chmap_instance->bt_channels[i].state == 2) &&
				    chmap_instance->bt_channels[i].rating > best_rating) {
					best_rating = chmap_instance->bt_channels[i].rating;
					best_channel = i;
				}
			}

			if (best_channel >= 0) {
				int byte_index = best_channel / 8;
				int bit_index = best_channel % 8;
				chmap_instance->suggested_chn_bitmask[byte_index] |=
					(1 << bit_index);
				chmap_instance->bt_channels[best_channel].state = 1;
				active_count++;
			}
		}
	}

	chmap_instance->active_channel_count = active_count;
}

static void reset_sample_counters(struct chmap_instance *chmap_instance)
{
	for (int i = 0; i < CHMAP_BT_CONN_CH_COUNT; i++) {
		chmap_instance->bt_channels[i].total_packets_sent = 0;
		chmap_instance->bt_channels[i].total_crc_ok = 0;
		chmap_instance->bt_channels[i].total_crc_errors = 0;
		chmap_instance->bt_channels[i].total_rx_timeouts = 0;
	}

	chmap_instance->processed_samples_count = 0;
	chmap_instance->evaluations_since_last_evaluation = 0;
}

void set_suggested_bitmask_to_current_bitmask(struct chmap_instance *chmap_instance)
{
	if (!chmap_instance) {
		printk("chmap_instance is NULL");
		return;
	}

	uint8_t *new_channel_map = channel_map_filter_algo_get_channel_map(chmap_instance);
	if (!new_channel_map) {
		printk("new_channel_map is NULL");
		return;
	}

	memcpy(chmap_instance->current_chn_bitmask, new_channel_map, CHMAP_BLE_BITMASK_SIZE);
}
```
